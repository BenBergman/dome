/*
  Digital Pot Control

  This example controls an Analog Devices AD5206 digital potentiometer.
  The AD5206 has 6 potentiometer channels. Each channel's pins are labeled
  A - connect this to voltage
  W - this is the pot's wiper, which changes when you set it
  B - connect this to ground.

 The AD5206 is SPI-compatible,and to command it, you send two bytes,
 one with the channel number (0 - 5) and one with the resistance value for the
 channel (0 - 255).

 The circuit:
  * All A pins  of AD5206 connected to +5V
  * All B pins of AD5206 connected to ground
  * An LED and a 220-ohm resisor in series connected from each W pin to ground
  * CS - to digital pin 10  (SS pin)
  * SDI - to digital pin 11 (MOSI pin)
  * CLK - to digital pin 13 (SCK pin)

 created 10 Aug 2010
 by Tom Igoe

 Thanks to Heather Dewey-Hagborg for the original tutorial, 2005

*/


// inslude the SPI library:
#include <SPI.h>


// set pin 10 as the slave select for the digital pot:
const int latchPin = 2;

bool manual = false;

int frame = 0;
unsigned long frameDuration = 150;
unsigned long lastFrameTime = 0;

void setup() {
  // set the latchPin as an output:
  pinMode (latchPin, OUTPUT);
  // initialize SPI:
  SPI.begin();

  lastFrameTime = millis();
}

unsigned int data[][7] = {
  // Cycle through banks
  //   6     5     4     3     2     1     0
  /*
  */
  { 0x00, 0x00, 0x00, 0x00, 0x00, 0x00, 0xFF, },
  { 0x00, 0x00, 0x00, 0x00, 0x00, 0xFF, 0x00, },
  { 0x00, 0x00, 0x00, 0x00, 0xFF, 0x00, 0x00, },
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  { 0xFF, 0x00, 0x00, 0x00, 0x00, 0x00, 0x00, },

  // Cycle down rings
  { 0x08, 0x08, 0x00, 0x08, 0x08, 0x00, 0x08, },
  { 0x10, 0x10, 0x11, 0x10, 0x10, 0x11, 0x10, },
  { 0x20, 0x21, 0x22, 0x01, 0x21, 0x22, 0x21, },
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  { 0x84, 0x84, 0x88, 0x84, 0x84, 0x88, 0x84, },

  /*
  { 0x00, 0x00, 0x00, 0x00, 0x00, 0x00, 0x00, },
  */
};

void loop() {
  if (!manual) {
    for (int i = 0; i < (sizeof(data[frame])/sizeof(data[frame][0])); i++) {
      SPI.transfer(data[frame][i]);
    }
    digitalWrite(latchPin, LOW);
    digitalWrite(latchPin, HIGH);
  }


  if (millis() - lastFrameTime > frameDuration) {
    lastFrameTime = millis();
    frame = (frame + 1) % (sizeof(data)/sizeof(data[0]));
  }


  if (Serial.available() > 0) {
    manual = true;
    String str = Serial.readStringUntil('\n');
    unsigned int val = strtoul(str.c_str(), NULL, 16);

    SPI.transfer(val);

    digitalWrite(latchPin, LOW);
    digitalWrite(latchPin, HIGH);
  }
}
